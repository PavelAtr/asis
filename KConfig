## KConfig
```kconfig
choice HYPERVISOR
    prompt "Select hypervisor for run on"
    default LINUX
config LINUX
    bool "Linux as hypervisor"
config UEFI
    bool "UEFI as hypervisor"
endchoice



menu "Core"

choice ARCHITECTURE
    prompt "Select architecture"
    default X86_64
config X86_64
    bool "AMD64 architecture"
config OTHER_ARCH
    bool "Other architectures (not supported)"
endchoice

endmenu




menu "Drivers"

source "drv/hostfs/Kconfig"
source "drv/uefifs/Kconfig"
source "drv/tty/Kconfig"
source "drv/fbgop/Kconfig"
source "drv/loop/Kconfig"
source "drv/dummyblk/Kconfig"
source "drv/lintrap/Kconfig"

endmenu



menu "Userspace"
source "userspace/Kconfig"
endmenu
```

## drv/dummyblk/Kconfig
```kconfig
config DUMMYBLK
      bool "Dummy block device"
      default y
      help
        Dummy block device (for hostfs uefifs for example).
```

## drv/fbgop/Kconfig
```kconfig
config FBGOP
      bool "Framebuffer via UEFI GOP"
      depends on UEFI
      default y
      help
        Framebuffer via UEFI GOP.
```

## drv/hostfs/Kconfig
```kconfig
config HOSTFS
      bool "Host filesystem"
      default y
      help
        Proxy root filesystem to host filesystem as is.
```

## drv/lintrap/Kconfig
```kconfig
config LINTRAP
      bool "Trap linux signals"
      depends on LINUX
      default y
      help
        Trap linux signals as SIGSEGV SIGABRT ... and proxy to current
	guest application.
```

## drv/loop/Kconfig
```kconfig
config LOOP
      bool "Simple loop"
      default y
      help
	Simple loop file as blk device
```

## drv/tty/Kconfig
```kconfig
config TTY
      bool "Simple console"
      default y
      help
        Proxy tty to core main executable stdin stdout stderr
	e.g. hypervisor console
```

## drv/uefifs/Kconfig
```kconfig
config UEFIFS
      bool "UEFI host filesystem"
      depends on UEFI
      default y
      help
        Proxy root filesystem to host filesystem as is.
```

## drv/uefikeyboard/Kconfig
```kconfig
config UEFIKEYBOARD
      bool "Simple UEFI keyboard"
      depends on UEFI
      default y
      help
        Simple UEFI keyboard driver
```

## drv/uefimouse/Kconfig
```kconfig
config UEFIMOUSE
      bool "Simple UEFI mouse"
      depends on UEFI
      default y
      help
        Simple UEFI mouse driver
```

## userspace/Kconfig
```kconfig
config ALIBC
      bool "ASIS libc"
      default y
      help
        ASIS libc for core syscalls.

config LIBDL
      bool "ASIS elf loader library"
      default y
      help
        ASIS elf loader library.

config LIBPWD
      bool "ASIS passwd library"
      default y
      help
        ASIS passwd library for /etc/passwd /etc/group.

config ATHREADS
      bool "ASIS pthread library"
      default y
      help
        ASIS very simple library for pthreads.

config AMATH
      bool "ASIS libm library"
      default y
      help
        ASIS math library for libm.

config ALIBGLOB
      bool "ASIS libglob library"
      default y
      help
        ASIS glob library.

config TESTAPP
      bool "ASIS own simple binaries"
      default y
      help
        ASIS own simple binaries.

config MRSH
      bool "mrsh"
      default y
      help
        Mrsh shell.

config COREUTILS
      bool "coreutils"
      default y
      help
        Coreutils suite of programs.

config LIBFFI
      bool "libffi"
      default y
      help
        libffi library.

config EXPAT
      bool "expat"
      default y
      help
        expat package.

config ZLIB
      bool "zlib"
      default y
      help
        zlib package.

config XZUTILS
      bool "xz-utils"
      default y
      help
        xz-utils package.

config LIBXML
      bool "libxml"
      default y
      help
        libxml package.

config WAYLAND
      bool "wayland"
      default y
      help
        wayland package.

config WAYLANDPROTOCOLS
      bool "wayland-protocols"
      default y
      help
        wayland-protocols package.

config LIBGLVND
      bool "libglvnd"
      default y
      help
        libglvnd package.

config LIBDRM
      bool "libdrm"
      default y
      help
        libdrm package.

config EUDEV
      bool "eudev"
      default y
      help
        eudev library.

config LIBKMS
      bool "libkms"
      default y
      help
        libkms package.

config WAYLANDKMS
      bool "wayland-kms"
      default y
      help
        wayland-kms package.


config LIBGBM
      bool "libgbm"
      default y
      help
        libgbm package.


config MTDEV
      bool "mtdev"
      default y
      help
        mtdev package.

config LIBEVDEV
      bool "libevdev"
      default y
      help
        libevdev library.

config LIBINPUT
      bool "libinput"
      default y
      help
        libinput library.

config LIBXKBCOMMON
      bool "libxkbcommon"
      default y
      help
        libxkbcommon library.

config PIXMAN
      bool "pixman"
      default y
      help
        pixman package.


config WLROOTS
      bool "wlroots"
      default y
      help
        wlroots library.
```
